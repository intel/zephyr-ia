## Kconfig.intel
```kconfig
# Copyright (c) 2020-2022 Intel Corp.
# SPDX-License-Identifier: Apache-2.0

menu "Intel Internal"

rsource "services/Kconfig"
endmenu
```

## services/Kconfig
```kconfig
#Placeholder to add Kconfig other services like eclite, oob, etc
#Uncomment below placeholder when the respective services is enabled.

rsource "sys_services/Kconfig"
rsource "user_app_framework/Kconfig"
rsource "fw_version/Kconfig"
```

## services/sys_services/Kconfig
```kconfig
config SYS_IA_SERVICE
	bool "SYS Service"
	help
	  Enable System service.

rsource "host_services/Kconfig"
```

## services/sys_services/host_services/Kconfig
```kconfig
# Kconfig - pse-host communication configuration options
#
# Copyright (c) 2021 Intel Corporation
#
# SPDX-License-Identifier: Apache-2.0
#

menu "host_service"

config HOST_IA_SERVICE
	bool "HOST_IA_SERVICE support"
	select IPC
	help
	  This option enables pse-host communication support.

if HOST_IA_SERVICE
config SYS_MNG
	bool "System Management Protocol support"
	default n
	help
	  Pse-host system management commands handling.

config HECI
	bool "HECI Protocol support"
	default n
	help
	  Enable host HECI protocol

if HECI
rsource "heci/Kconfig"
endif

endif
endmenu

module = HECI_IA
module-str = heci
source "subsys/logging/Kconfig.template.log_config"

module = SYS_MNG_IA
module-str = sys_mng_ia
source "subsys/logging/Kconfig.template.log_config"
```

## services/sys_services/host_services/heci/Kconfig
```kconfig
# Kconfig - host communication configuration options
#
# Copyright (c) 2021 Intel Corporation
#
# SPDX-License-Identifier: Apache-2.0
#

comment "pse-host HECI protocol support"

config SMHI
	bool "enable the SMHI client"
	default y
	help
	  SMHI is a basic system HECI client used by host to get basic
	  fw status and info

config HECI_MSG_DUMP
	bool "if HECI message dumping is neeed for debugging"
	depends on LOG
	help
	  This configuration is used for HECI debugging, to print all
	  HECI in/out message

config HECI_MAX_MSG_SIZE
	int "max message size of HECI protocol"
	default 4096
	help
	  Set this to config max message size of HECI protocol

config HECI_PAGE_SIZE
	int "max page size of HECI protocol"
	default 4096
	help
	  Set this to config page size of HECI protocol,
	  equals the page size of pse sram

config HECI_FLOW_CONTROL_WAIT_TIMEOUT
	int "timeout in ms to wait flow control when send heci message"
	default 5000
	help
	  The max time in ms that the heci client message sending will
	  wait for the flow control from peer client.

module = SMHI_IA
module-str = smhi
source "subsys/logging/Kconfig.template.log_config"
```

## west.yml
```yaml
# The west manifest file for upstream Zephyr.
#
# The per-installation west configuration file, .west/config, sets the
# path to the project containing this file in the [manifest] section's
# "path" variable.
#
# You are free to create your own manifest files and put them in any
# repository you want, to create your own custom Zephyr installations.
# For example, you could create a manifest file in your own out of
# tree application directory, which would pull this zephyr repository
# in as an ordinary project.
#
# You can pass your manifest repositories to west init when creating a
# new Zephyr installation. See the west documentation for more
# information.

manifest:
  defaults:
    remote: upstream

  remotes:
    - name: intel
      url-base: https://github.com/intel
    - name: upstream
      url-base: https://github.com/zephyrproject-rtos


  #
  # Please add items below based on alphabetical order
  projects:

    - name: zephyr
      path: zephyr
      revision: intel-ehl-ia
      remote: intel
      import:
        name-whitelist:
          - ci-tools
          - civetweb
          - fatfs
          - mbedtls
          - net-tools
          - segger
          - tinycrypt

    - name: sedi-drivers
      revision: zephyr-ia
      remote: intel
      path: modules/hal/intel
    - name: rtos-if-drivers
      revision: zephyr-ia
      remote: intel
      path: zephyr-iotg

  self:
    path: zephyr-ia
    west-commands: scripts/west-commands.yml
```
